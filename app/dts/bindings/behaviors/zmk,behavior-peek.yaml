## app/dts/bindings/behaviors/zmk,behavior-peek.yaml
```yaml
# Copyright (c) 2020 The ZMK Contributors
# SPDX-License-Identifier: MIT

description: Peek Binding Behavior

compatible: "zmk,behavior-peek"

include: one_param.yaml
```
